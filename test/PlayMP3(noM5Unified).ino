
#include "Arduino.h"
#include <Wire.h>
#include "XPowersLib.h"    // Библиотека питания
#include "Audio.h"           // Ваша библиотека ESP32-audioI2S
#include "SPI.h"
#include "SD.h"

// Явно дублируем пины из config.h для чистоты теста
#define SD_SPI_CS_PIN   4
#define SD_SPI_SCK_PIN  18
#define SD_SPI_MISO_PIN 38
#define SD_SPI_MOSI_PIN 23

#define I2S_BCLK_PIN    12 
#define I2S_LRCK_PIN    0  
#define I2S_DOUT_PIN    2  

XPowersAXP192 localPmu;
Audio audio;

void setup() {
    Serial.begin(115200);
    delay(1000);
    Serial.println("\n=== СТАРТ ТЕСТА: ЧИСТАЯ МУЗЫКА В ПОЛНОЙ ТИШИНЕ ЗУММЕРА ===");

    // =========================================================================
    // ШАГ 1. АППАРАТНОЕ УНИЧТОЖЕНИЕ ЗУММЕРА И СТАБИЛИЗАЦИЯ ПИТАНИЯ
    // =========================================================================
    Wire.begin(21, 22);
    if (localPmu.begin(Wire, 0x34, 21, 22)) {
        localPmu.setDC3Voltage(3300);  // Ток на экран и подсветку LovyanGFX
        
        // 🔥 УДАР №1: Полностью выключаем линию LDO3, обесточивая цепи пищалки!
        localPmu.disableLDO3(); 
        
        // 🔥 УДАР №2: Подаем чистые 3.3В на линию LDO2, чтобы ожила MicroSD-карта
        localPmu.setLDO2Voltage(3300); 
        localPmu.enableLDO2();         

        // 🔥 УДАР №3: Заземляем базу транзистора через регистр 0x94 значением 0x02
        // Это наглухо запирает ключ зуммера и одновременно активирует аудиоусилитель NS4168
        Wire.beginTransmission(0x34); 
        Wire.write(0x94); 
        Wire.write(0x02); // Жесткий выход LOW — полная изоляция пищалки
        Wire.endTransmission();
        
        Serial.println("[POWER] Зуммер аппаратно обесточен. Усилитель музыки включен.");
    }
    // Даем паузу 300 мс, чтобы контроллер MicroSD-карты успел зарядить конденсаторы и включиться
    delay(300); 

    // =========================================================================
    // ШАГ 2. АППАРАТНЫЙ ЗАПУСК И МОНТИРОВАНИЕ MicroSD КАРТЫ ПО ШИНЕ SPI
    // =========================================================================
    SPI.begin(SD_SPI_SCK_PIN, SD_SPI_MISO_PIN, SD_SPI_MOSI_PIN, SD_SPI_CS_PIN);
    if (!SD.begin(SD_SPI_CS_PIN, SPI, 25000000)) {
        Serial.println("[КРИТИЧЕСКАЯ ОШИБКА] Не удалось смонтировать SD-карту!");
        while(true) delay(100); // Стопорим плату при аварии файловой системы
    }
    Serial.println("[SD] Карта памяти успешно смонтирована.");

    // =========================================================================
    // ШАГ 3. НАСТРОЙКА АУДИОДВИЖКА ПОД МОНО-ДИНАМИК CORE2
    // =========================================================================
    // Назначаем физические пины встроенного динамика из вашего config.h (12, 0, 2)
    audio.setPinout(I2S_BCLK_PIN, I2S_LRCK_PIN, I2S_DOUT_PIN);
    
    // Смешиваем левый и правый каналы стерео-файла в один моно-микшер встроенного динамика.
    // Без этой команды один из каналов просто теряется, вызывая хрипы.
    audio.forceMono(true);   
    
    audio.setVolume(14);     // Комфортная средняя громкость без цифрового перегруза
    audio.setTone(8, 12, 12); // Ваши сочные настройки частот эквалайзера

    // =========================================================================
    // ШАГ 4. ЗАПУСК ВОСПРОИЗВЕДЕНИЯ ФАЙЛА С ФЛЕШКИ
    // =========================================================================
    if (!audio.connecttoFS(SD, "/Beatles-Girl.mp3")) {
        Serial.println("[ОШИБКА] Файл /Beatles-Girl.mp3 не найден на SD-карте!");
        while(true) delay(100);
    }
    Serial.println("[AUDIO] Поток Битлз успешно запущен в шину I2S.");
}


void loop() {
    // В изолированном тесте крутим loop без FreeRTOS на максимальной скорости процессора
    audio.loop();
}

// Вывод технических логов декодера в терминал
void audio_info(const char *info){
    Serial.print("[MP3 ENGINE]: "); Serial.println(info);
}

// код - смерть зуммеру - если он жужжит и жужжит
/*

#include "Arduino.h"
#include <Wire.h>
#include "XPowersLib.h" // Подключаем библиотеку питания

XPowersAXP192 localPmu;

void setup() {
    Serial.begin(115200);
    delay(1000);
    Serial.println("\n=== УЛЬТИМАТИВНЫЙ ТЕСТ ВЫКЛЮЧЕНИЯ ЗУММЕРА ===");

    // Инициализируем шину I2C для прямой связи с регистрами чипа питания
    Wire.begin(21, 22);

    if (localPmu.begin(Wire, 0x34, 21, 22)) {
        // 1. Стабилизируем базовые линии, чтобы плата не выключилась
        localPmu.setDC3Voltage(3300);  // Ток на экран LovyanGFX
        localPmu.setLDO2Voltage(3300); // Ток на слот SD-карты
        localPmu.enableLDO2();

        // 🔥 ШАГ 1: ПОЛНОСТЬЮ ОТКЛЮЧАЕМ ЛИНИЮ LDO3
        // На некоторых ревизиях Core2 зуммер жестко запитан от LDO3. 
        // Мы принудительно гасим этот канал питания, чтобы обесточить пищалку!
        localPmu.disableLDO3(); 

        // 🔥 ШАГ 2: БЬЕМ ПО РЕГИСТРУ GPIO4 ЧИПА ПИТАНИЯ (УПРАВЛЕНИЕ SHUTDOWN ДЛЯ ЗВУКА)
        // Запись значения 0x02 переводит ножку GPIO4 чипа AXP192 в режим выхода LOW (0 Вольт).
        // На плате Core2 это физически притягивает базу транзистора к земле, 
        // намертво закрывая ключ зуммера.
        Wire.beginTransmission(0x34); 
        Wire.write(0x94); // Регистр конфигурации GPIO4 чипа AXP192
        Wire.write(0x02); // Значение: Выход LOW (Жесткое глушение)
        Wire.endTransmission();

        Serial.println("[AXP192] Команды жесткого глушения LDO3 и GPIO4 отправлены.");
    }

    // 🔥 ШАГ 3: НАСТРОЙКА САМОЙ НОЖКИ ПРОЦЕССОРА (GPIO2)
    // Переводим пин GPIO2 в режим входа БЕЗ подтяжки (Floating Input).
    // В таком режиме этот пин физически "висит в воздухе" внутри процессора ESP32,
    // не выдавая ни малейшего ШИМ-тока или потенциала, способного заставить зуммер пищать.
    pinMode(2, INPUT); 
    
    Serial.println("[SYSTEM] Ножка GPIO2 переведена в режим входа. Ждем тишину...");
}

void loop() {
    // В цикле мы ничего не делаем — плата должна хранить мертвую, абсолютную тишину.
    // Если в динамике или зуммере слышны хоть какие-то шорохи, пишите в чат.
    Serial.println("[STATUS] Система в режиме ожидания. Зуммер обязан молчать.");
    delay(2000);
}
*/